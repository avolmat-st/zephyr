## samples/drivers/video/tcpserversink/boards/stm32n6570_dk_stm32n657xx_sb.conf
```kconfig
# Video buffer pool
CONFIG_VIDEO_BUFFER_POOL_SZ_MAX=10000000
CONFIG_VIDEO_BUFFER_POOL_NUM_MAX=10

# Camera interface
CONFIG_VIDEO_STM32_DCMIPP_SENSOR_PIXEL_FORMAT="pRAA"
CONFIG_VIDEO_STM32_DCMIPP_SENSOR_WIDTH=2592
CONFIG_VIDEO_STM32_DCMIPP_SENSOR_HEIGHT=1944
CONFIG_FPU=y

# Capture
CONFIG_VIDEO_FRAME_WIDTH=320
CONFIG_VIDEO_FRAME_HEIGHT=240
CONFIG_VIDEO_PIXEL_FORMAT="NV12"
CONFIG_VIDEO_CAPTURE_N_BUFFERING=2

# Video encoder
#CONFIG_VIDEO_STM32_VENC=y
#CONFIG_MAIN_STACK_SIZE=4096
CONFIG_VIDEO_ENCODED_PIXEL_FORMAT="JPEG"
CONFIG_MAIN_STACK_SIZE=4196

# Network buffers
CONFIG_NET_BUF_RX_COUNT=4
CONFIG_NET_BUF_TX_COUNT=8
```
